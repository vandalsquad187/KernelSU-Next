## kernel/Kconfig
```kconfig
menu "KernelSU"

config KSU
	tristate "KernelSU function support"
	depends on KPROBES && EXT4_FS
	default y
	help
	  Enable kernel-level root privileges on Android System.

config KSU_KPROBES_KSUD
	bool "Enable dynamic kprobes for early boot hooks"
	depends on KPROBES && KRETPROBES
	default y
	help
	  Use dynamic hooks via kprobes for functions only
	  on early boot. Hooks are unregistered at boot complete
	  to reduce overhead.

config KSU_HACK_ARM64_BRANCH_LINK
	bool "EXPERIMENTAL: inline call-site hijacking (ARM64 bl insn)"
	depends on ARM64 && KALLSYMS && KSU_KPROBES_KSUD
	depends on !KSU_TAMPER_SYSCALL_TABLE
	default n
	help
	  EXPERIMENTAL: provide sucompat by patching callsites by scanning kernel text and 
	  patching bl (branch-with-link) insn. This routes call into our custom functions
	  without proper trampolines. Theory comes from ARM64 optprobes that are still NOT 
	  merged on mainline. (128MB limit, kernel-inbuilt-only)
	  Kprobes is required for sys_newfstat and sys_reboot hooks as this is NOT handled
	  currently with this method.
	  NOT recommended for pre-4.17 kernels. For those, please use KSU_TAMPER_SYSCALL_TABLE.
	  Verified on Android 6.12 GKI.

config KSU_TAMPER_SYSCALL_TABLE
	bool "EXPERIMENTAL: tamper sys_call_table for sucompat + sys_reboot"
	depends on (ARM || ARM64) && !CFI_CLANG && !CFI
	default n
	help
	  EXPERIMENTAL: use syscall table hijacking method demonstrated on zx2c4's
	  kernel-assisted-superuser. Replaces sys_reboot, sys_execve, sys_newfstatat,
	  sys_faccessat, sys_newfstat_ret manual hooks.
	  Personally tested on Linux 3.0 (arm) and 3.10 ~ 4.14 (aarch64).
	  Verified on 3.0 ~ 6.1.

config KSU_FEATURE_SULOG
	bool "KernelSU SU Logging feature"
	depends on KSU
	default y
	help
	  Build KernelSU's SU Log.

config KSU_FEATURE_ADBROOT
	bool "KernelSU ADB Root feature"
	depends on KSU
	default y
	help
	  Build KernelSU's adb root feature.

config KSU_DEBUG
	bool "KernelSU debug mode"
	depends on KSU
	default n
	help
	  Enable KernelSU debug mode.

config KSU_DISABLE_MANAGER
	bool "Disable KernelSU manager integration"
	depends on KSU
	default n
	help
	  Disable manager APK detection and manager-specific handling.
	  Root will be used in place of manager-only functionality.

config KSU_LSM_SECURITY_HOOKS
	bool "Use LSM security hooks"
	depends on KSU
	default y
	help
	  Disabling this is mostly useful for non-ARM64 with kernel > 6.8.
	  Make sure to implement manual hooks on security/security.c.

menuconfig KSU_SUSFS
	bool "KernelSU SUnsupported Filesystem (SUSFS) 2.0"
	depends on KSU
	default n
	help
	  Enable KernelSU SUnsupported Filesystem (SUSFS) support.

if KSU_SUSFS

config KSU_SUSFS_ENABLE_LOG
	bool "Enable SUSFS logging"
	default y
	help
	  Enable logging for SUSFS operations.

config KSU_SUSFS_SUS_PATH
	bool "SUSFS hide sus path"
	default y

config KSU_SUSFS_SUS_MOUNT
	bool "SUSFS hide sus mounts"
	default y

config KSU_SUSFS_SUS_KSTAT
	bool "SUSFS spoof kstat"
	default y

config KSU_SUSFS_SUS_MAP
	bool "SUSFS spoof map"
	default y

config KSU_SUSFS_OPEN_REDIRECT
	bool "SUSFS open redirect"
	default y

config KSU_SUSFS_TRY_UMOUNT
	bool "SUSFS try umount"
	default y

config KSU_SUSFS_SPOOF_CMDLINE_OR_BOOTCONFIG
	bool "SUSFS spoof cmdline/bootconfig"
	default y

config KSU_SUSFS_SPOOF_UNAME
	bool "SUSFS spoof uname"
	default y

config KSU_SUSFS_HIDE_KSU_SUSFS_SYMBOLS
	bool "SUSFS hide symbols"
	default y

endif

endmenu
```
